/* Includes ------------------------------------------------------------------*/
#include "user_includes.h"
#include <stdio.h>
//-------------------------------------------------------
u16 const DATA_RESTORE[CS_NUM]={
//------------------------------一些开关信号参数-------------------------------------------------
							 1,/*语音开关,0,1*/
							 1,/*假币计数否,0 1*/
							 1,/*张数对比，0，关对比，显示面额，1，开对比*/
							 3,/*外显示选择，0，电脑通信，1. 3位侧显示+1616外显  2,合计金额侧显示，3，3位侧显示+合计金额外显
										4.合计外显+合计侧显*/
							 160,/*磁性门槛*/
							 3,/*液晶背光关闭时间，时间单位为分钟*/
							 32,/*刹车时间10-100*/
	
//-------------------------------与机器使用相关的传感器灵敏度设置，不影响抓假------------------------------------------------
	
							 4,/*启动光耦灵敏度,越小灵敏度越高*/
							 4,/*接钞光耦灵敏度,越小灵敏度越高*/
							 200,/*计数管门槛,幅面变大调大*/
							 10,/*单计数管补漏时间。*/
	
//---------------------------------与抓假相关的灵敏度设置-----------------------------------------
	
							 0,		/* 重张*/
							 3,		/*连张*/
							 4,		/*UV数据*/
							 2,		/*磁性数据*/
							 2,		/*USD磁性数据*/
							 2,		/*边磁数据*/
							 0,		/*调节幅面*/
//----------------------------------光亮度设置的参数PWM 占空比  %---------------------------------------------
							 60,	/*左计数对管发射*/
							 60,	/*右计数对管发射*/
							 100,	/*荧光1发射*/	
							 100,	/*荧光2发射*/
//-----------------------------------------------------------------------------------------
							 0,		/*默认清点国别币种*/
//----------------------------------------END------------------------------------------------------------------		
							 0,0,0,0,0,0,

						     };		//EEPROM中存储的参数
//---------------------------------------------------------
/*****************************************/
int main(void)
{
///******************************************************************/
	RCC_Config();			//时钟配置
	InterruptConfig();		//NVIC配置初始化
	Systick_Config();		//时基配置
	SysHardwave_Config();	//初始化系统基础IO，例MP IRC_MP,NVIC
	Struct_Init();			//初始化结构体变量
	Motor_Config();			//电机初始化
	ADC_Config();	 		//ADC IO配置	
	DMA_Config();	 		//DMA ADC配置
	LCD_Config();			//LCD配置
	CISUsart_Config();		//CIS串口配置
//	KEY_Config();			//按键配置
	Voice_Init();			//初始化VOICE芯片
/************************读出存储中的参数信息************************/
	First_Use();			//如果是第一次使用。读出参数到各类结构体中	//
	Timer_Config();			//配置定时器PWM
/*******************************************************************/
	Motor_On();				    //电机启动
	FillDisplay();
	VoiceWelcome();	
	USB_Config();			//U盘初始化配置
	OffPowerKeyAnalysis();	//判断有无开机前的按键操作。
	Test();					    //测试传感器错误
	fifo_Init();
	Spi2SlaveInit();
/******************************************************************/
	while(1)
	{
//------------依据条件，处理CIS命令---------------------------------
		CIS_DealCommand(); 
//---------------------检测-------------------------------------------------
		USB_CheckReady();//
//------------------------------------------------------------------------
		if(g_SysType.b_1ms)
		{
			g_SysType.b_1ms = 0;
			CheckStar(); //检测光耦启动信号 
			if(g_SysType.f_rest) CheckReset();//检测复位信号。
			OutBill();//检测接钞台有无钞票。 
			Beepcon();
			if(!g_SysType.f_run)
			{
//-----------------------------------------------------------------------
				g_KeyType.KeyCode = ReadKey();
				if(g_KeyType.KeyCode!= NOKEYPRESS)	
				{
					SplitKeyCode(g_KeyType.KeyCode); //解析键码，执行相应的任务
					DispOpenBL();
				}
//-----------------------------------------------------------------------        
			}
		}
		if(g_SysType.f_star)	  //如果有进钞
		{
			DispOpenBL();
			DealBill();//开始读钞
		}
		if(g_SysType.b_2s&&(!g_SysType.f_run))
		{
			g_SysType.b_2s = 0;
			LCD_Init();
			Display();
		}
	}
}
